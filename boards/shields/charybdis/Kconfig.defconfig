## boards/shields/charybdis/Kconfig.defconfig
```kconfig
if SHIELD_CHARYBDIS_RIGHT_STANDALONE || SHIELD_CHARYBDIS_RIGHT_STANDALONE_RGB

config ZMK_KEYBOARD_NAME
	default "Charybdis"

config ZMK_SPLIT_BLE_ROLE_CENTRAL
	default y

endif

if SHIELD_DONGLE_CHARYBDIS_RIGHT || SHIELD_DONGLE_CHARYBDIS_RIGHT_RGB

config ZMK_KEYBOARD_NAME
	default "Charybdis Right"

endif

if SHIELD_DONGLE_PROSPECTOR || SHIELD_DONGLE_BWSHOCKLEY_PROSPECTOR

config ZMK_KEYBOARD_NAME
	default "Charybdis"

config ZMK_SPLIT_BLE_ROLE_CENTRAL
	default y

endif

if SHIELD_DONGLE_ZDSE_PROSPECTOR

config ZMK_KEYBOARD_NAME
	default "Charybdis"

config ZMK_SPLIT_BLE_ROLE_CENTRAL
	default y

# ST7789V pixel format and backlight dependencies previously provided by
# carrefinho's prospector_adapter shield
choice ST7789V_PIXEL_FORMAT
	default ST7789V_RGB565
endchoice

config PWM
	default y

config LED
	default y

endif

if SHIELD_DONGLE_NICE || SHIELD_DONGLE_NICE_ROUND

config ZMK_KEYBOARD_NAME
	default "Charybdis"

config ZMK_SPLIT_BLE_ROLE_CENTRAL
	default y

endif

if SHIELD_CHARYBDIS_LEFT_RGB || SHIELD_CHARYBDIS_RIGHT_STANDALONE_RGB || SHIELD_DONGLE_CHARYBDIS_RIGHT_RGB

config SPI
	default y

config LED_STRIP
	default y

config ZMK_RGB_UNDERGLOW
	default y

endif

if SHIELD_CHARYBDIS_LEFT || SHIELD_CHARYBDIS_LEFT_RGB || SHIELD_CHARYBDIS_RIGHT_STANDALONE || SHIELD_CHARYBDIS_RIGHT_STANDALONE_RGB || SHIELD_DONGLE_CHARYBDIS_RIGHT || SHIELD_DONGLE_CHARYBDIS_RIGHT_RGB || SHIELD_DONGLE_PROSPECTOR || SHIELD_DONGLE_NICE || SHIELD_DONGLE_BWSHOCKLEY_PROSPECTOR || SHIELD_DONGLE_ZDSE_PROSPECTOR || SHIELD_DONGLE_NICE_ROUND

config ZMK_SPLIT
	default y

endif
```

## boards/shields/charybdis/Kconfig.shield
```kconfig
config SHIELD_CHARYBDIS_LEFT
	def_bool $(shields_list_contains,charybdis_left)

config SHIELD_CHARYBDIS_RIGHT_STANDALONE
	def_bool $(shields_list_contains,charybdis_right_standalone)

config SHIELD_DONGLE_CHARYBDIS_RIGHT
	def_bool $(shields_list_contains,dongle_charybdis_right)

config SHIELD_DONGLE_NICE_ROUND
	def_bool $(shields_list_contains,dongle_nice_round)
```

## boards/shields/dongle_screen/Kconfig.shield
```kconfig
config SHIELD_DONGLE_SCREEN
	def_bool $(shields_list_contains,dongle_screen)

if SHIELD_DONGLE_SCREEN

config DONGLE_ROUND_SCREEN
	bool "Enable custom round status screen for ZMK dongle"
	default y
	depends on ZMK_DISPLAY

config DONGLE_ROUND_SCREEN_SWAP_SIDES
	bool "Swap left and right halves on the round dongle screen"
	default n

endif
```
